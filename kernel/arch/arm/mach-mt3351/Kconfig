## kernel/arch/arm/mach-mt3351/Kconfig
```kconfig
if ARCH_MT3351


menu "MT3351 Board Support Package"

comment "MT3351 Board Type"

choice
bool "Board"

config MT3351_EVB_BOARD
	bool "MT3351 EVB Board"
	depends on ARCH_MT3351
	default y
	help
		Select if you are using an EVB board

config MT3351_EVK_BOARD
	bool "MT3351 EVK Board"
	depends on ARCH_MT3351
	default n
	help
		Select if you are using an EVK board

config MT3351_EVZ_BOARD
	bool "MT3351 EVZ Board"
	depends on ARCH_MT3351
	default n
	help
		Select if you are using an EVK board

endchoice

choice

bool "MCU TYPE"

config MT3351_CPU_208MHZ_MCU_104MHZ
	bool "MT3351 CPU 208MHz + EMI 104MHz"
    depends on ARCH_MT3351
    help
          Enable 208 MHz clock for MT3351 CPU. If unsure, say N.

config MT3351_CPU_416MHZ_MCU_104MHZ
	bool "MT3351 CPU 416MHz + EMI 104MHz"
    depends on ARCH_MT3351
	default n
	help
          Enable 416MHz clock for MT3351 CPU. If unsure, say Y.

config MT3351_CPU_468MHZ_MCU_117MHZ
	bool "MT3351 CPU 468MHz + EMI 117MHz"
    depends on ARCH_MT3351
    default y
	help
          Enable 468MHz clock for MT3351 CPU. If unsure, say N.
endchoice

endmenu



endif
```

## kernel/arch/arm/mach-mt6516/Kconfig
```kconfig
if ARCH_MT6516


menu "MT6516 Board Support Package"

comment "MT6516 Board Type"

choice
bool "Board"

config MT6516_EVB_BOARD
	bool "MT6516 EVB Board"
	depends on ARCH_MT6516
	help
		Select if you are using an EVB board

config MT6516_PHONE_BOARD
	bool "MT6516 PHONE Board"
	depends on ARCH_MT6516
	help
		Select if you are using an phone board

config MT6516_GEMINI_BOARD
	bool "MT6516 GEMINI Board"
	depends on ARCH_MT6516
	help
		Select if you are using an phone board

config MT6516_OPPO_BOARD
	bool "MT6516 OPPO Board"
	depends on ARCH_MT6516
	help
		Select if you are using an phone board

config MT6516_E1K_BOARD
	bool "MT6516 E1000 Board"
	depends on ARCH_MT6516
	help
		Select if you are using an phone board

endchoice

config MT6516_GEMAX_BOARD
	bool "MT6516 GEMAX Board (GEMINI with WIMAX)"
	depends on ARCH_MT6516 && MT6516_GEMINI_BOARD
	help
		Select if you are using an GEMINI with wimax phone board

choice

bool "MCU TYPE"

config MT6516_CPU_208MHZ_MCU_104MHZ
	bool "MT6516 CPU 208MHz + EMI 104MHz"
    depends on ARCH_MT6516
    help
          Enable 208 MHz clock for MT6516 CPU. If unsure, say N.

config MT6516_CPU_416MHZ_MCU_104MHZ
	bool "MT6516 CPU 416MHz + EMI 104MHz"
    depends on ARCH_MT6516
	help
          Enable 416MHz clock for MT6516 CPU. If unsure, say Y.

config MT6516_CPU_468MHZ_MCU_117MHZ
	bool "MT6516 CPU 468MHz + EMI 117MHz"
        depends on ARCH_MT6516
	help
          Enable 468MHz clock for MT6516 CPU. If unsure, say N.
endchoice

config MAX_DRAM_SIZE_SUPPORT
	hex "The maximum size of the DRAM can be supported in the kernel"
	default 0x8000000
	depends on ARCH_MT6516
	help
		Define the maximum size of the kernel can be supported.
	        If will modify the memory size if it size is smaller than 
                the memory size passed by the boot loader to the MAX_DRAM_SIZE_S                UPPORT.
   		Notice that the maximum DRAM size is including the memory size
	        reserved for the modem and the PMEM.

config CEVA_MT6516
	bool "Enable CEVA"
	depends on ARCH_MT6516
	default y
	help
		Enable CEVA

config RESERVED_MEM_SIZE_FOR_CEVA
	hex "Reserved memory size for CEVA"
	default 0x400000
	depends on ARCH_MT6516 && CEVA_MT6516
	help
		Configure the reserved memory size for CEVA.
        	The tag.mem.size will be deduced by the reserved size 
	        in the "fixup" function.


config RESERVED_MEM_SIZE_FOR_PMEM
	hex "Reserved memory size for PMEM"
	default 0x1400000
	depends on ARCH_MT6516
	help
		Configure the reserved memory size for PMEM. 
        	The tag.mem.size will be deduced by the reserved size 
	        in the "fixup" function.

config AEE_FEATURE
	tristate "Enable Android Exception Enhancement"
	default n
	depends on APANIC
	select CRC32
	help
		Enable Android Exception Enhancement

endmenu



endif
```

## kernel/drivers/MPEG4/Kconfig
```kconfig
menu "MPEG4 encoder driver"
    depends on ARCH_MT6516
    config MPEG4_ENCDRV
	tristate "MPEG4 encoder driver"
	default y
endmenu 
```

## kernel/drivers/MPEG4_Decoder/Kconfig
```kconfig
menu "MT6516 MPEG4_Decoder Driver"
    depends on ARCH_MT6516
    config MPEG4_Decoder_DRIVER
	    tristate "MT6516 MPEG4_Decoder Driver"	
	    default y
endmenu
```

## kernel/drivers/actuator/Kconfig
```kconfig
menuconfig ACTUATOR
	tristate "actuator drivers"
	default y
	---help---
	  Say Y here for supporting actuator.

if ACTUATOR

#
# FM50AF configuration
#

config FM50AF
	tristate "FM50AF driver"
	depends on ARCH_MT6516 && ACTUATOR=y
	default y
	---help---
	  FM50AF lens module driver

endif # ACTUATOR
```

## kernel/drivers/gps/Kconfig
```kconfig
menuconfig GPS
	tristate "GPS drivers"
	default y
	---help---
	  Say Y here for supporting GPS.

if GPS

config MT6516_GPS
	tristate "MT6516 GPS driver"
	depends on ARCH_MT6516 && GPS=y
	default y
	---help---
	  MT6516 internal GPS driver

endif # GPS
```

## kernel/drivers/h264_decoder/Kconfig
```kconfig
menu "MT6516 H264 Decoder Driver"
    depends on ARCH_MT6516
    config H264_DECODER_DRIVER
	    tristate "MT6516 H264 Decoder Driver"	
	    default y
endmenu
```

## kernel/drivers/hwmon/mt6516/Kconfig
```kconfig
config SENSORS_MT6516
	tristate "MediaTek MT6516 Sensor"
	depends on I2C && ARCH_MT6516
	help
	  Say Y here if you have MediaTek MT6516 sensor.

	  If unsure, say N.

	  To compile this driver as a module, choose M here: the
	  module will be called mt6516_sensor.

menu "MT6516 Sensor Library"

config SENSOR_LIB_HWMSEN
    bool "hwmsen library"
    depends on SENSORS_MT6516
    help
      Set the option as yes if you want to use hwmsen sensor library

config SENSOR_LIB_AMIT
    bool "AMIT library"
    depends on SENSORS_MT6516
    help
      Set the option as yes if you want to use AMIT sensor library
           
config SENSORS_ADXL345
	bool "Analog Devices ADXL345"
	depends on SENSOR_LIB_AMIT || SENSOR_LIB_HWMSEN
	help
	  If you say yes here you get support for the Analog Devices
	  AXDL345 motion monitoring chips.

config SENSORS_KXTE91026
	bool "Kionix KXTE9-1026"
	depends on SENSOR_LIB_AMIT || SENSOR_LIB_HWMSEN
	help
	  If you say yes here you get support for the Kionix 
	  KXTE9-1026 motion monitoring chips.

config SENSORS_AMI304
	bool "Aichi Steel AMI304"
	depends on SENSOR_LIB_AMIT || SENSOR_LIB_HWMSEN
	help
	  If you say yes here you get support for the Aichi Stell 
	  AMI304 magnetic sensor

config SENSORS_CM3623
	bool "Capella CM3623"
	depends on SENSOR_LIB_AMIT || SENSOR_LIB_HWMSEN
	help
	  If you say yes here you get support for the Capella
	  CM3623 ALS/PS sensor

endmenu
     

     
```

## kernel/drivers/image/Kconfig
```kconfig
menu "MT6516 Image Option"
    depends on ARCH_MT6516



config JPEG_MT6516
	tristate "JPEG driver"
	default y
	
endmenu

			 
# EOF
```

## kernel/drivers/input/touchscreen/mt6516/Kconfig
```kconfig
config TOUCHSCREEN_MT6516
	tristate "MediaTek MT6516 Touch Panel"
	depends on ARCH_MT6516
	help
	  Say Y here if you have MediaTek MT6516 touch panel.

	  If unsure, say N.

	  To compile this driver as a module, choose M here: the
	  module will be called mt6516_ts.
```

## kernel/drivers/m3d/Kconfig
```kconfig
menu "MT6516 M3D Device Driver"
    depends on ARCH_MT6516
	config M3D_DRIVER
		tristate "MT6516 M3D Device Driver"
		default y
endmenu
```

## kernel/drivers/matv/Kconfig
```kconfig
menu "MT6516 MATV Driver"
    depends on ARCH_MT6516
    config MATV_DRIVER
	    tristate "MT6516 MATV Driver"	
	    default y
endmenu
```

## kernel/drivers/meta/Kconfig
```kconfig
menu "MT6516 META"
    depends on ARCH_MT6516
    config META
	    tristate "MT6516 META"	
	    default y
endmenu
```

## kernel/drivers/monitor/Kconfig
```kconfig
menu "MT6516 MONITOR"
    depends on ARCH_MT6516
    config MONITOR
	    tristate "MT6516 MONITOR"	
	    default y
endmenu
```

## kernel/drivers/net/wimax/Kconfig
```kconfig
comment "Enable WiMAX (Networking options) to see the WiMAX drivers"
	depends on WIMAX = n

if WIMAX

menu "WiMAX Wireless Broadband devices"

source "drivers/net/wimax/i2400m/Kconfig"

endmenu

endif

menu "Mediatek WiMAX devices"

config WIMAX_MT71X8

    bool "MT71X8 devices driver"
    default n

endmenu
```

## kernel/drivers/video/mtk/Kconfig
```kconfig
config FB_MT6516
	bool "MediaTek (MT6516) LCD Driver"
	depends on FB && ARCH_MT6516
	select FB_CFB_FILLRECT
	select FB_CFB_COPYAREA
	select FB_CFB_IMAGEBLIT
	select FB_SOFT_CURSOR
	---help---
	  Framebuffer for MT6516

config FB_MT6516_SUPPORT_ASSERTION_LAYER
	bool "Support MT6516 Assertion Layer for AEE"
	depends on FB_MT6516
    select FONT_8x16
	default y
	---help---
	  Support MT6516 Assertion Layer for AEE

config FB_MT6516_EVB_USE_HVGA_LCM
	bool "Use MagnaChip TA7601 HVGA LCM on EVB"
	depends on FB_MT6516 && MT6516_EVB_BOARD
	default n
	---help---
	  Use MagnaChip TA7601 HVGA LCM on EVB
	  
config FB_MT6516_SIMULATE_MULTIPLE_RESOLUTIONS_ON_OPPO
	bool "Simulate multiple resolutions on MTK OPPO reference phone"
	depends on FB_MT6516 && MT6516_OPPO_BOARD
	default n
	---help---
	  Simulate multiple resolutions on MTK OPPO reference phone

config FB_MT6516_OPPO_SIMUL_WIDTH
	int "OPPO simulation width"
	depends on FB_MT6516_SIMULATE_MULTIPLE_RESOLUTIONS_ON_OPPO
	default 320
	---help---
	  OPPO simulation width

config FB_MT6516_OPPO_SIMUL_HEIGHT
	int "OPPO simulation height"
	depends on FB_MT6516_SIMULATE_MULTIPLE_RESOLUTIONS_ON_OPPO
	default 480
	---help---
	  OPPO simulation height
```

## kernel/drivers/video/mtk/g2d/Kconfig
```kconfig
config MT6516_G2D
	bool "MediaTek (MT6516) G2D Driver"
	depends on ARCH_MT6516
	---help---
	  MT6516 G2D Driver
```

## kernel/drivers/watchdog/wdk/Kconfig
```kconfig
menuconfig WD_KICKER
	tristate "WD_KICKER"
	default y
	---help---
	Watch dog kicker is a module in the kernel for kicking the watch dog
```

## kernel/sound/yususound/Kconfig
```kconfig
menu "MT6516 SOUND DIRVER"
    config SOUND_MT6516
    	bool "MT6516 SOUND DIRVER"
	    default y
endmenu
```
