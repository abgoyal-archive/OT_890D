// T32 Wed Sep 23 13:09:00 2009

 B::
 
 TOOLBAR ON
 STATUSBAR ON
 WINPAGE.RESET
 
 WINCLEAR
 WINPOS 167.13 20.5 69. 16. 0. 0. W000
 Var.Watch
 
 
 WINPOS 167.25 0.0625 44. 16. 0. 1. W007
 WINTABS 19. 7.
 sYmbol.Browse
 
 WINPOS 167.5 40.875 69. 12. 12. 1. W004
 WINTABS 13. 0. 0. 0. 0. 0. 0.
 Break.List
 
 WINPOS 0.0 48.75 112. 6. 0. 0. W005
 AREA
 
 WINPOS 115.75 37.0 48. 17. 0. 0. W006
 Register
 
 WINPOS 115.5 0.0 48. 32. 5. 0. W002
 v.f /l /c
 
 WINPOS 214.88 0.0 71. 15. 0. 0. W005
 SYStem
 
 WINPOS 0.125 0.125 112. 46. 13. 1. W000
 WINTABS 16. 10. 25. 62.
 d.l
 
 WINPAGE.SELECT P000     
 
 ENDDO
