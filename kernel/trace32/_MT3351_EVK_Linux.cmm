;System.Down
;TASK.RESet
;Break.Delete


System.RESet
Break.Delete 

MAP.RESet
sYmbol.RESet
MMU.RESet
GROUP.RESet

System.CPU ARM1176JZ
System.Option Cflush on    	;flush the cache to avoid data consistency
;System.JtagClock 26MHz
System.JtagClock ctck 4MHz
;System.JtagClock Rtck
;System.Option WaitReset on
;System.Option ResBreak off 	;Don't hold the ARM11 core after reset
System.Option EnReset off

 TrOnchip.Set DABORT OFF        ; used by Linux for page miss!
 TrOnchip.Set PABORT OFF        ; used by Linux for page miss!
 TrOnchip.Set UNDEF OFF         ; used to detect non-existent coprocessor
 SYStem.Option MMU ON           ; enable space ids to virtual addresses



SYStem.Up
;System.Option EnReset on
;SYStem.Up
Register.REset

;disbale interrupt during assembly step
SETUP.IMASKASM	ON
;disbale interrupt during C step
SETUP.IMASKHLL	ON

; turn off target mmu
 d.s c15:0x1 0

Y.SPATH.RESET ; reset all source path

Y.SPATH.SRD ../drivers/android
Y.SPATH.SRD ../drivers/mmc
Y.SPATH.SRD ../init
Y.SPATH.SRD ../kernel/
Y.SPATH.SRD ../arch/arm/mach-mt3351
Y.SPATH.SRD ../arch/arm/kernel
Y.SPATH.SRD ../arch/arm/mm
Y.SPATH.SRD ../drivers/
Y.SPATH.SRD ../fs
Y.SPATH.SRD ../mm
Y.SPATH.SRD ../drivers/video
Y.SPATH.SRD ../drivers/video/mtk

&smode=2; 1: DDR x16 (PLL104MHZ)

IF &smode==1  ; DDR x16 (PLL104MHZ)
(
    D.S SD:0x80020078 %LE %LONG 0x80000702  ; GENA from 70->78
    D.S SD:0x80020090 %LE %LONG 0x00010000  ; GEND from 88->90  //EVB
;104MHz setting start
    D.S SD:0x80020040 %LE %LONG 0x00334000  ; CONI
    ;D.S SD:0x80020048 %LE %LONG 0x2C732710  ; CONJ -7.5
    D.S SD:0x80020048 %LE %LONG 0x3CA33610  ; CONJ

    D.S SD:0x80020050 %LE %LONG 0x02900000  ; CONK
    ;D.S SD:0x80020050 %LE %LONG 0x01000000  ; CONK
    D.S SD:0x80020058 %LE %LONG 0x00037004  ; CONL

    D.S SD:0x80020080 %LE %LONG 0x00333330  ; GENB
    D.S SD:0x80020088 %LE %LONG 0x00333300  ; GENC
;104MHz setting end   

    D.S SD:0x80020068 %LE %LONG 0x10520001 ;
    D.S SD:0x80020068 %LE %LONG 0x08520001 ;
    D.S SD:0x80020068 %LE %LONG 0x04520001 ;
    D.S SD:0x80020068 %LE %LONG 0x02520001 ;
    D.S SD:0x80020068 %LE %LONG 0x01520001 ;
    D.S SD:0x80020068 %LE %LONG 0x00520103 ; 
)

IF &smode==2  ; DDR x16 (PLL117MHZ)
(
    D.S SD:0x80020078 %LE %LONG 0x80000702  ; GENA from 70->78
    D.S SD:0x80020090 %LE %LONG 0x00010000  ; GEND from 88->90  //EVB
;117MHz setting start
    D.S SD:0x80020040 %LE %LONG 0x00334000  ; CONI
    D.S SD:0x80020048 %LE %LONG 0x3CBB3710  ; CONJ
    ;D.S SD:0x80020048 %LE %LONG 0x3CF36623  ; CONJ
    ;D.S SD:0x80020048 %LE %LONG 0x3CFB6723  ; CONJ


    D.S SD:0x80020050 %LE %LONG 0x02900000  ; CONK
    ;D.S SD:0x80020050 %LE %LONG 0x01000000  ; CONK
    D.S SD:0x80020058 %LE %LONG 0x00037004  ; CONL

    D.S SD:0x80020080 %LE %LONG 0x00333330  ; GENB
    D.S SD:0x80020088 %LE %LONG 0x00333300  ; GENC
;117MHz setting end   

    D.S SD:0x80020068 %LE %LONG 0x10520001 ;
    D.S SD:0x80020068 %LE %LONG 0x08520001 ;
    D.S SD:0x80020068 %LE %LONG 0x04520001 ;
    D.S SD:0x80020068 %LE %LONG 0x02520001 ;
    D.S SD:0x80020068 %LE %LONG 0x01520001 ;
    D.S SD:0x80020068 %LE %LONG 0x00520103 ; 
)

do Linux.cmm
